## boards/arm/etee_dongle/Kconfig.defconfig
```kconfig
# Copyright (c) 2024 Nordic Semiconductor ASA
# SPDX-License-Identifier: Apache-2.0

if BOARD_ETEE_DONGLE

config BOARD
	default "etee_dongle"

config BT_CTLR
   default BT


endif
```

## boards/arm/nrf52840-dk_nrf52840/Kconfig.board
```kconfig
# Copyright (c) 2024 Nordic Semiconductor ASA
# SPDX-License-Identifier: Apache-2.0

config BOARD_NRF52840_DK_NRF52840
	bool "nrf52840-dk_nrf52840"
	select SOC_DCDC_NRF52X
	depends on SOC_NRF52840_QIAA
```

## boards/arm/nrf52840-dk_nrf52840/Kconfig.defconfig
```kconfig
# Copyright (c) 2024 Nordic Semiconductor ASA
# SPDX-License-Identifier: Apache-2.0

if BOARD_NRF52840_DK_NRF52840

config BOARD
	default "nrf52840-dk_nrf52840"

config BT_CTLR
   default BT


endif
```
